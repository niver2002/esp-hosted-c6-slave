## sdkconfig.defaults
```kconfig
# BT Configuration (禁用以节省资源)
CONFIG_BT_ENABLED=n
# CONFIG_BT_CONTROLLER_ONLY=y

# OTA
CONFIG_ESPTOOLPY_FLASHSIZE_4MB=y
CONFIG_PARTITION_TABLE_TWO_OTA=y

# OS
CONFIG_FREERTOS_HZ=1000
CONFIG_ESP_WIFI_NVS_ENABLED=y
CONFIG_BOOTLOADER_COMPILER_OPTIMIZATION_PERF=y

#Disable enterprise support by default
CONFIG_ESP_WIFI_ENTERPRISE_SUPPORT=n

# ============================================================
# SDIO Performance Configuration
# ============================================================
CONFIG_ESP_SDIO_TX_Q_SIZE=40
CONFIG_ESP_SDIO_RX_Q_SIZE=40

# ============================================================
# WiFi Buffer Configuration (increased for throughput)
# ============================================================
CONFIG_ESP_WIFI_STATIC_RX_BUFFER_NUM=24
CONFIG_ESP_WIFI_DYNAMIC_RX_BUFFER_NUM=64
CONFIG_ESP_WIFI_DYNAMIC_TX_BUFFER_NUM=64
```

## sdkconfig.defaults.backup
```kconfig
# ============================================================
# ESP-Hosted Slave Common Configuration (ESP-IDF v6.1)
# ============================================================

# 1. BT Configuration (禁用以节省资源)
#--------------------------------------
CONFIG_BT_ENABLED=n
# CONFIG_BT_CONTROLLER_ONLY=y

# 2. OTA Configuration
#---------------------
CONFIG_ESPTOOLPY_FLASHSIZE_4MB=y
CONFIG_PARTITION_TABLE_TWO_OTA=y

# 3. OS Configuration
#--------------------
CONFIG_FREERTOS_HZ=1000
CONFIG_ESP_WIFI_NVS_ENABLED=y

# ESP-Hosted task priority (提高到23，确保WiFi发送优先)
CONFIG_ESP_HOSTED_DEFAULT_TASK_PRIORITY=23

# 4. Bootloader Optimization
#----------------------------
CONFIG_BOOTLOADER_COMPILER_OPTIMIZATION_PERF=y
# Use Log V2 for bootloader (ESP-IDF v6.1)
CONFIG_BOOTLOADER_LOG_LEVEL_INFO=y

# 5. WiFi Configuration
#----------------------
# Disable enterprise support by default
CONFIG_ESP_WIFI_ENTERPRISE_SUPPORT=n

# 6. Compiler Optimization
#--------------------------
CONFIG_COMPILER_OPTIMIZATION_PERF=y
CONFIG_COMPILER_OPTIMIZATION_ASSERTIONS_ENABLE=y

# 7. Log Configuration (ESP-IDF v6.1)
#-------------------------------------
CONFIG_LOG_VERSION_2=y
CONFIG_LOG_DEFAULT_LEVEL_INFO=y
CONFIG_LOG_COLORS=y
```

## sdkconfig.defaults.esp32c6
```kconfig
# 0. REALTIME OPTIMIZATION
#--------------------------
# Disable power management for lowest latency
CONFIG_PM_ENABLE=n

# 1. CPU
#--------
CONFIG_ESP_DEFAULT_CPU_FREQ_MHZ_160=y

# 2. BT Configuration (禁用以节省资源)
#---------------------
CONFIG_BT_ENABLED=n
# CONFIG_BT_CONTROLLER_ONLY=y
# CONFIG_BT_BLUEDROID_ENABLED=
# CONFIG_BT_LE_SLEEP_ENABLE=y

# 3.1 BLE over SPI/SDIO (禁用)
#-----------------------
# CONFIG_BT_LE_HCI_INTERFACE_USE_RAM=y

# 3.2 BLE over UART (禁用)
#-------------------
# CONFIG_BT_LE_HCI_INTERFACE_USE_UART=n


# 4. Partition Table
#--------------------
CONFIG_PARTITION_TABLE_CUSTOM=y
CONFIG_PARTITION_TABLE_CUSTOM_FILENAME="partitions.esp32c6.csv"

# 5. Mempool
#------------
CONFIG_ESP_CACHE_MALLOC=n


# 6 Network split
#-----------------

#  # 6.1 LWIP split
#  #---------------
#
#  CONFIG_LWIP_TCP_LOCAL_PORT_RANGE_START=61440
#  CONFIG_LWIP_TCP_LOCAL_PORT_RANGE_END=65535
#  CONFIG_LWIP_UDP_LOCAL_PORT_RANGE_START=61440
#  CONFIG_LWIP_UDP_LOCAL_PORT_RANGE_END=65535
#
#  # 6.2 LWIP split examples (禁用所有示例)
#  #-------------------------
#  CONFIG_ESP_HOSTED_COPROCESSOR_EXAMPLE_MQTT=n
#  CONFIG_ESP_HOSTED_COPROCESSOR_EXAMPLE_HTTP_CLIENT=n

# 6.3 禁用多余功能（只保留WiFi转发核心功能）
#----------------------------------------------------
CONFIG_ESP_HOSTED_CLI_ENABLED=n
CONFIG_ESP_HOSTED_COPROCESSOR_EXAMPLE_MQTT=n
CONFIG_ESP_HOSTED_COPROCESSOR_EXAMPLE_HTTP_CLIENT=n


# 7. Transport config
#---------------------
# SDIO timing优化（PSEND_PSAMPLE可提供更好性能）
CONFIG_ESP_SDIO_PSEND_PSAMPLE=y
# SDIO High Speed: 启用高速模式（SDIO标准HS=50MHz，匹配Host 50MHz）
CONFIG_ESP_SDIO_HIGH_SPEED=y
# SDIO Streaming Mode: 启用以获得最佳吞吐量
CONFIG_ESP_SDIO_STREAMING_MODE=y

# SDIO队列大小优化（必须与P4端匹配: 40/40）
CONFIG_ESP_SDIO_TX_Q_SIZE=40
CONFIG_ESP_SDIO_RX_Q_SIZE=40
# 禁用软件校验（SDIO硬件已有CRC）
CONFIG_ESP_SDIO_CHECKSUM=n

# For SPI Full duplex C6 on ESP32-P4-Function-EV-Board, please uncomment below
#CONFIG_ESP_HOST_DEV_BOARD_P4_FUNC_BOARD=y
#CONFIG_ESP_SPI_HOST_INTERFACE=y


# 8. Wifi config（性能优化）
#----------------
CONFIG_WIFI_CMD_BASIC_ONLY=y

# WiFi buffer优化：增大RX buffer以提高下载吞吐量
# P4端已做聚合，C6 TX压力小；下载方向RX是瓶颈
CONFIG_ESP_WIFI_STATIC_RX_BUFFER_NUM=20
CONFIG_ESP_WIFI_DYNAMIC_RX_BUFFER_NUM=64
CONFIG_ESP_WIFI_DYNAMIC_TX_BUFFER_NUM=48

# AMPDU配置：匹配P4端配置（两端BA_WIN都是32）
CONFIG_ESP_WIFI_AMPDU_TX_ENABLED=y
CONFIG_ESP_WIFI_TX_BA_WIN=32
CONFIG_ESP_WIFI_AMPDU_RX_ENABLED=y
CONFIG_ESP_WIFI_RX_BA_WIN=32

CONFIG_ESP_WIFI_RX_IRAM_OPT=y
CONFIG_ESP_WIFI_IRAM_OPT=y

# 9. LWIP config
#----------------
CONFIG_LWIP_TCP_SND_BUF_DEFAULT=11520
CONFIG_LWIP_TCP_WND_DEFAULT=11520
CONFIG_LWIP_TCP_RECVMBOX_SIZE=16
CONFIG_LWIP_UDP_RECVMBOX_SIZE=16
CONFIG_LWIP_TCPIP_RECVMBOX_SIZE=32
CONFIG_LWIP_TCP_SACK_OUT=y
CONFIG_LWIP_TCPIP_CORE_LOCKING=y
CONFIG_LWIP_TCPIP_CORE_LOCKING_INPUT=y


# 10. Optimizations
#-------------------
CONFIG_COMPILER_OPTIMIZATION_PERF=y
CONFIG_ESPTOOLPY_FLASHMODE_QIO=y
CONFIG_ESPTOOLPY_FLASHFREQ_80M=y


# 11. Stats (Optional - 生产环境建议禁用)
#----------------------
#CONFIG_ESP_HOSTED_FUNCTION_PROFILING=y
#CONFIG_ESP_PKT_STATS=y

# 12. 禁用不必要的调试功能（节省Flash和RAM）
#-----------------------------------------------
# 禁用GDBSTUB（除非需要调试）
CONFIG_ESP_GDBSTUB_ENABLED=n

# 禁用Core Dump（生产环境可禁用）
# CONFIG_ESP_COREDUMP_ENABLE_TO_FLASH is not set
# CONFIG_ESP_COREDUMP_ENABLE_TO_UART is not set

# 禁用Task Watchdog（如果不需要）
# CONFIG_ESP_TASK_WDT_EN=n

# 禁用Interrupt Watchdog的超时打印（减少日志）
CONFIG_ESP_INT_WDT_CHECK_CPU1=n

# 13. 其他优化配置
#-------------------
# 减少默认任务栈大小（根据实际需求调整）
CONFIG_ESP_MAIN_TASK_STACK_SIZE=4096
CONFIG_ESP_SYSTEM_EVENT_TASK_STACK_SIZE=3072

# 禁用不需要的协议栈功能
CONFIG_ESP_WIFI_ENTERPRISE_SUPPORT=n

# 使用Newlib nano格式化（节省Flash）
CONFIG_LIBC_NEWLIB_NANO_FORMAT=y
```
